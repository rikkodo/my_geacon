## config/boards/shields/Test/Kconfig.defconfig
```kconfig
if SHIELD_TEST_DONGLE

config ZMK_KEYBOARD_NAME
    default "Test_Dongle"

config ZMK_SPLIT
    default y

config ZMK_SPLIT_ROLE_CENTRAL
    default y

endif

if SHIELD_TEST_R

config ZMK_KEYBOARD_NAME
    default "Test_R"

config ZMK_SPLIT
    default y

endif

if SHIELD_TEST_L

config ZMK_KEYBOARD_NAME
    default "Test_L"

config ZMK_SPLIT
    default y

endif
```

## config/boards/shields/Test/Kconfig.shield
```kconfig
config SHIELD_TEST_DONGLE
    def_bool $(shields_list_contains,Test_Dongle)

config SHIELD_TEST_R
    def_bool $(shields_list_contains,Test_R)

config SHIELD_TEST_L
    def_bool $(shields_list_contains,Test_L)
```

## config/boards/shields/geacon dm/Kconfig.defconfig
```kconfig
if SHIELD_GEACON_DM
  config ZMK_KEYBOARD_NAME
  default "geacon_dm"
endif

config SPI
    default y
```

## config/boards/shields/geacon_inv/Kconfig.defconfig
```kconfig
if SHIELD_GEACON_INV
  config ZMK_KEYBOARD_NAME
  default "geacon_inv"
endif

config SPI
    default y
```

## config/boards/shields/geacon_jis/Kconfig.defconfig
```kconfig
if SHIELD_GEACON_JIS
  config ZMK_KEYBOARD_NAME
  default "Geacon_JIS"
endif

config SPI
    default y
```
